## sources/meta-bootgen/conf/layer.conf
```bitbake
LAYER_NAME = "meta-bootgen"
LAYER_VERSION = "1.0"
LAYER_ARCH = "all"
LICENSE = "CLOSED"

BBPATH .= ":${LAYERDIR}"

BBFILES += "${LAYERDIR}/recipes-*/*/*.bb \
            ${LAYERDIR}/recipes-*/*/*.bbappend"

BBFILE_COLLECTIONS += "bootgen"
BBFILE_PATTERN_bootgen = "^${LAYERDIR}/"

LAYERVERSION_bootgen = "1"
LAYERSERIES_COMPAT_bootgen = "nanbield"
```
